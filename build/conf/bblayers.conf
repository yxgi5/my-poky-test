## build/conf/bblayers.conf
```bitbake
# POKY_BBLAYERS_CONF_VERSION is increased each time build/conf/bblayers.conf
# changes incompatibly
POKY_BBLAYERS_CONF_VERSION = "2"

BBPATH = "${TOPDIR}"
BBFILES ?= ""

BBLAYERS ?= " \
  /home/andy/Downloads/poky/meta \
  /home/andy/Downloads/poky/meta-poky \
  /home/andy/Downloads/poky/meta-yocto-bsp \
  /home/andy/Downloads/poky/meta-mylayer \
  /home/andy/Downloads/poky/build/workspace \
  "
```
